## boards/nrf5340_audio_dk_nrf5340_cpuapp.conf
```kconfig
#
# Copyright (c) 2024 Nordic Semiconductor ASA
#
# SPDX-License-Identifier: LicenseRef-Nordic-5-Clause
#

CONFIG_NRF5340_AUDIO_CS47L63_DRIVER=y
CONFIG_NRF5340_AUDIO_POWER_MEASUREMENT=y
CONFIG_NRF5340_AUDIO_SD_CARD_MODULE=y

# Enable low-level peripherals used directly by the audio stack
CONFIG_NRFX_I2S=y
CONFIG_NRFX_TIMER=y
CONFIG_PINCTRL=y
```

## src/debug/Kconfig
```kconfig
#
# Copyright (c) 2022 Nordic Semiconductor
#
# SPDX-License-Identifier: LicenseRef-Nordic-5-Clause
#

#----------------------------------------------------------------------------#
menu "Debug and Monitoring"

config HEAPS_MONITOR
	bool "Enable heap memory monitoring"
	select  SYS_HEAP_LISTENER
    default n
	help
	  Enable heap memory monitoring system that tracks allocations and frees
	  for system heap and registered custom heaps. Provides intelligent
	  logging with peak usage tracking and periodic status updates.

module = HEAPS_MONITOR
module-str = heaps_monitor
source "subsys/logging/Kconfig.template.log_config"

endmenu # "Debug and Monitoring"
```

## src/net/Kconfig
```kconfig
#
# Copyright (c) 2024 Nordic Semiconductor
#
# SPDX-License-Identifier: LicenseRef-Nordic-5-Clause
#

#------------------------------------------------------------------------#
menu "NETWORK Module"

choice NETWORK_CONNECT_METHOD
	prompt "Choose network connection methods"
	default CONNECT_WITH_WIFI

config CONNECT_WITH_WIFI
	bool "Connect devices with Wi-Fi network"

# config CONNECT_WITH_DECTNR
# 	bool "Connect devices with DECT NR+ network"

endchoice # NETWORK_CONNECTION_METHOD

endmenu #"NETWORK Module"

#------------------------------------------------------------------------#
menu "Socket Utilities"

config SOCKET_UTILS
	bool "Enable socket utilities module"
	default y
	help
	  Enable socket utilities module for network communication.

if SOCKET_UTILS

choice SOCKET_TYPE
	prompt "Socket type"
	default SOCKET_TYPE_UDP

config SOCKET_TYPE_UDP
	bool "UDP socket"
	help
	  Use UDP sockets for communication.

config SOCKET_TYPE_TCP
	bool "TCP socket"
	help
	  Use TCP sockets for communication.

endchoice # SOCKET_TYPE

choice SOCKET_ROLE
	prompt "Socket role"
	default SOCKET_ROLE_SERVER

config SOCKET_ROLE_SERVER
	bool "Socket server"
	help
	  Device acts as socket server.

config SOCKET_ROLE_CLIENT
	bool "Socket client"
	help
	  Device acts as socket client.

endchoice # SOCKET_ROLE

config SOCKET_STACK_SIZE
	int "Socket thread stack size"
	default 6144
	help
	  Stack size for socket thread.

config SOCKET_UTILS_THREAD_PRIO
	int "Socket thread priority"
	default 3
	help
	  Priority for socket thread.

config SOCKET_UTILS_LOG_LEVEL
	int "Socket Utilities log level"
	default 3
	range 0 4
	help
	  Sets log level for Socket Utilities module.
	  Levels are:
	  - 0 OFF, do not write
	  - 1 ERROR, only write LOG_ERR
	  - 2 WARNING, write LOG_WRN in addition to previous level
	  - 3 INFO, write LOG_INF in addition to previous levels
	  - 4 DEBUG, write LOG_DBG in addition to previous levels

menu "mDNS settings"
  config MDNS_QUERY_NAME
      string "mDNS query name"
      default "zephyr"
      help
        Set the mDNS query name

  config MDNS_QUERY_ATTEMPTS
      int "mDNS query attempts"
      default 5
      help
        Set the number of mDNS query attempts
endmenu # "mDNS settings"

endif # SOCKET_UTILS

endmenu # "Socket Utilities"

menu "SoftAP Configuration"

config SOFTAP_REG_DOMAIN
	string "SoftAP regulatory domain"
	default "00"
	help
	  Regulatory domain for SoftAP mode.

config SOFTAP_SSID
	string "SoftAP SSID"
	default "AudioGateway_AP"
	help
	  SSID for SoftAP mode.

config SOFTAP_PASSWORD
	string "SoftAP password"
	default "Auido@WIFI"
	help
	  Password for SoftAP mode.

endmenu # "SoftAP Configuration"

#------------------------------------------------------------------------#
module = NETWORK_MODULE
module-str = NETWORK module
source "subsys/logging/Kconfig.template.log_config"
```

## wifi_audio/Kconfig.sysbuild
```kconfig
#
# Copyright (c) 2024 Nordic Semiconductor
#
# SPDX-License-Identifier: LicenseRef-Nordic-5-Clause
#

# For now, we don't need the network core image for this WiFi audio demo
# This can be changed later if RPMSG/IPC communication is needed
config NRF_DEFAULT_EMPTY
	default y

source "share/sysbuild/Kconfig" 
```
