## CMakeLists.txt
```
#
# Copyright (c) 2022 Nordic Semiconductor ASA
#
# SPDX-License-Identifier: LicenseRef-Nordic-5-Clause
#

cmake_minimum_required(VERSION 3.20.0)

# Flag which defines whether application is compiled as gateway/dongle or headset
add_compile_definitions(HEADSET=1)
add_compile_definitions(GATEWAY=2)

find_package(Zephyr REQUIRED HINTS $ENV{ZEPHYR_BASE})

project(wifi_audio_transceiver)

string(TIMESTAMP NRF5340_AUDIO_CORE_APP_COMP_DATE "%a %b %d %H:%M:%S %Y")
message(NRF5340_WIFI_AUDIO_COMP_DATE="${NRF5340_AUDIO_CORE_APP_COMP_DATE}")

# Generate fw_info_app.c
configure_file("${CMAKE_CURRENT_SOURCE_DIR}/src/utils/fw_info_app.c.in"
               "${CMAKE_BINARY_DIR}/fw_info_app.c"
               @ONLY)

# Target sources below are specific to the nRF5340 Audio DK HW
target_sources(app PRIVATE
    ${CMAKE_BINARY_DIR}/fw_info_app.c
    )
if (CONFIG_AUDIO_HEADSET)
	add_subdirectory(wifi_audio_headset)
endif()

if (CONFIG_AUDIO_GATEWAY)
	add_subdirectory(wifi_audio_gateway)
endif()
# target_include_directories(app PUBLIC
zephyr_library_include_directories(
        include
        src
        src/audio
        src/net
        src/drivers
        src/modules
        src/utils
        src/utils/macros
        src/debug
        # ${ZEPHYR_NRF_MODULE_DIR}/boards/arm/nrf5340_audio_dk_nrf5340
        )

zephyr_library_include_directories(app PRIVATE
${ZEPHYR_NRF_MODULE_DIR}/boards/arm/nrf5340_audio_dk_nrf5340)

add_subdirectory(lib)
add_subdirectory(src/audio)
add_subdirectory(src/net)
add_subdirectory(src/drivers)
add_subdirectory(src/modules)
add_subdirectory(src/utils)
add_subdirectory(src/debug)

## Cirrus Logic
if (CONFIG_HW_CODEC_CIRRUS_LOGIC)
    if (ZEPHYR_CIRRUS_LOGIC_MODULE_DIR)
        add_subdirectory(${ZEPHYR_CIRRUS_LOGIC_MODULE_DIR} cirrus_logic_bin_dir)
    else()
        message(FATAL_ERROR "Cirrus Logic/sdk-mcu-drivers repository not found\n")
    endif()
endif()

# build counter
# Set a cached variable for the build count (default is 0)
if(NOT DEFINED WIFI_AUDIO_CMAKE_BUILD_COUNT)
    set(WIFI_AUDIO_CMAKE_BUILD_COUNT 0 CACHE STRING "Number of times the project has been built")
endif()
# Increment the build count
math(EXPR WIFI_AUDIO_CMAKE_BUILD_COUNT "${WIFI_AUDIO_CMAKE_BUILD_COUNT} + 1")
# Update the cached value
set(WIFI_AUDIO_CMAKE_BUILD_COUNT ${WIFI_AUDIO_CMAKE_BUILD_COUNT} CACHE STRING "Number of times the project has been built" FORCE)
# Print the current build count to the console
message(STATUS "Build count: ${WIFI_AUDIO_CMAKE_BUILD_COUNT}")
```

## Kconfig
```
#
# Copyright (c) 2024 Nordic Semiconductor
#
# SPDX-License-Identifier: LicenseRef-Nordic-5-Clause
#

#------------------------------------------------------------------------#
rsource "Kconfig.defaults"

menu "WiFi Audio Transceiver"
          
choice AUDIO_DEV_ROLE
	prompt "Choose device role from transmite, receiver and walkie talkie"
	default AUDIO_GATEWAY

config AUDIO_GATEWAY
	bool "Play audio stream transmiter role"

config AUDIO_HEADSET
	bool "Play audio stream receiver role"

endchoice #AUDIO_DEV_ROLE

config AUDIO_WALKIE_TALKIE
	bool "Enable walkie talkie feature, can enabled on both gateway and headset"
        default n

endmenu # "Audio Stream Transceiver"

if (AUDIO_GATEWAY = y)
rsource "wifi_audio_gateway/Kconfig.defaults"
endif

if (AUDIO_HEADSET = y)
rsource "wifi_audio_headset/Kconfig.defaults"
endif 

rsource "src/audio/Kconfig"
rsource "src/net/Kconfig"
rsource "src/drivers/Kconfig"
rsource "src/modules/Kconfig"
rsource "src/utils/Kconfig"
rsource "src/debug/Kconfig"

#------------------------------------------------------------------------#
menu "Logging"

module = MAIN
module-str = main
source "subsys/logging/Kconfig.template.log_config"

config PRINT_STACK_USAGE_MS
	depends on THREAD_ANALYZER && INIT_STACKS
	int "Print stack usage every x milliseconds"
	default 5000

endmenu # Log levels

source "Kconfig.zephyr"
```

## Kconfig.defaults
```
#
# Copyright (c) 2022 Nordic Semiconductor ASA
#
# SPDX-License-Identifier: LicenseRef-Nordic-5-Clause
#

config REBOOT
	default n

config MAIN_THREAD_PRIORITY
	default 10

config MAIN_STACK_SIZE
	default 1800 if SD_CARD_PLAYBACK
	default 1600

config SYSTEM_WORKQUEUE_STACK_SIZE
	default 1200

# As long as thread names are used, config must be set to "y"
config THREAD_NAME
	default y

# This configuration is obsolete in NCS v3.0.2, removing it
# config NCS_INCLUDE_RPMSG_CHILD_IMAGE
#	default n

# Workaround to not use fatal_error.c in NCS. Note that the system may still
# reset on error depending on the build configuraion
config RESET_ON_FATAL_ERROR
	default n

# # Default Config for Debug and Release build
# config BT
# 	default y

# config BOARD_ENABLE_DCDC_APP
# 	default y

# config BOARD_ENABLE_DCDC_NET
# 	default y

# config BOARD_ENABLE_CPUNET
# 	default y

config ZBUS
	default y

config ZBUS_RUNTIME_OBSERVERS
	default y

config ZBUS_MSG_SUBSCRIBER
	default y

config SENSOR
	default y

config REGULATOR
	default y

config CONTIN_ARRAY
	default y

config PCM_MIX
	default y

config PSCM
	default y

config DATA_FIFO
	default y

# Enable NRFX_CLOCK for ACLK control
config NRFX_CLOCK
	default y

config I2C
	default y

choice LIBC_IMPLEMENTATION
	# NOTE: Since we are not using minimal libc, error codes from
	#       minimal libc are not used
	default NEWLIB_LIBC
endchoice

# Audio codec LC3 related defines
# FPU_SHARING enables preservation of the hardware floating point registers
# across context switches to allow multiple threads to perform concurrent
# floating point operations.
config FPU
	default y

config FPU_SHARING
	default y

# Enable SDHC interface
config DISK_DRIVERS
	default y

config DISK_DRIVER_SDMMC
	default y

# Enable SPI interface
config SPI
	default y

# Enable ADC for board version readback
config ADC
	default y

# Allocate buffer on RAM for transferring chunck of data
# from Flash to SPI
config SPI_NRFX_RAM_BUFFER_SIZE
	default 8

# Config the file system
config FILE_SYSTEM
	default y

config FAT_FILESYSTEM_ELM
	default y

config FS_FATFS_LFN
	default y
choice FS_FATFS_LFN_MODE
	# Using stack for LFN work queue
	default FS_FATFS_LFN_MODE_STACK
endchoice

# exFAT enabled to support longer file names and higher transfer speed
config FS_FATFS_EXFAT
	default y

# Set the maximum file name length to 255
config FS_FATFS_MAX_LFN
	default 255

config WATCHDOG
	default y

config TASK_WDT
	default y
```

## west.yml
```
# Copyright (c) 2025 Nordic Semiconductor ASA
# SPDX-License-Identifier: LicenseRef-Nordic-5-Clause

manifest:
  self:
    path: nordic_wifi_opus_audio_demo

  remotes:
    - name: ncs
      url-base: https://github.com/nrfconnect

  projects:
    - name: nrf
      remote: ncs
      repo-path: sdk-nrf
      revision: v3.2.1
      import: true
```

## prj.conf
```kconfig
#
# Copyright (c) 2025 Nordic Semiconductor ASA
#
# SPDX-License-Identifier: LicenseRef-Nordic-5-Clause
#

#------------------------------------------------------------------------#
# -Application Configuration START
CONFIG_SOCKET_STACK_SIZE=6144
CONFIG_ENCODER_STACK_SIZE=24000
CONFIG_BUTTON_PUBLISH_STACK_SIZE= 512
# -Application Configuration END
#------------------------------------------------------------------------#

#------------------------------------------------------------------------#
# -General Kernel Options START
CONFIG_MAIN_STACK_SIZE=4096
CONFIG_SYSTEM_WORKQUEUE_STACK_SIZE=2048
CONFIG_HEAP_MEM_POOL_SIZE=70000
CONFIG_INIT_STACKS=y
# -General Kernel Options END
#------------------------------------------------------------------------#

#------------------------------------------------------------------------#
# -General Architecture Options START
# --Interrupt Configuration START
CONFIG_ISR_TABLES_LOCAL_DECLARATION=y #depended by CONFIG_LTO
# --Interrupt Configuration END
# -General Architecture Options END
#------------------------------------------------------------------------#

#------------------------------------------------------------------------#
# -Device Drivers START
# --Flash drivers START
CONFIG_FLASH=y
# CONFIG_FLASH_PAGE_LAYOUT=y #selected by CONFIG_NVS
# ---Flash map abstraction module START
CONFIG_FLASH_MAP=y
# ---Flash map abstraction module END
# --Flash drivers END
# --Wi-Fi drivers START
CONFIG_WIFI=y
CONFIG_WIFI_CREDENTIALS=y
CONFIG_WIFI_CREDENTIALS_SHELL=y
CONFIG_WIFI_CREDENTIALS_CONNECT_STORED=y
CONFIG_WIFI_NM_WPA_SUPPLICANT=y #select POSIX_API POSIX_TIMERS NET_SOCKETS
# SoftAP disable auto disconnect
# CONFIG_WIFI_MGMT_AP_STA_INACTIVITY_TIMEOUT=0 
# CONFIG_WIFI_MGMT_AP_STA_SKIP_INACTIVITY_POLL=n 
# --Wi-Fi drivers END
# -Device Drivers START
#------------------------------------------------------------------------#

# Suppress the old USB device stack deprecation warning
CONFIG_DEPRECATION_TEST=y

# Required by WPA supplicant EAPOL
CONFIG_NET_L2_ETHERNET=y

#------------------------------------------------------------------------#
# Modules START
# --Nordic nRF Connect START
# CONFIG_MAIN_STACK_SIZE= #Multiple definitions
# ---Subsystems START
# ----Networking START
# ----- Application Protocol START
# ------Wi-Fi Ready Library START
# CONFIG_WIFI_READY_LIB=y # replaced by WPA supplicant event check
# ------Wi-Fi Ready Library END
# ----- Application Protocol END
# -----L2 Wi-Fi Connectivity START
CONFIG_L2_WIFI_CONNECTIVITY=y #depends on NET_CONNECTION_MANAGER select NET_CONNECTION_MANAGER_CONNECTIVITY_WIFI_MGMT
CONFIG_L2_WIFI_CONNECTIVITY_AUTO_CONNECT=y
CONFIG_L2_WIFI_CONNECTIVITY_AUTO_DOWN=y
# -----L2 Wi-Fi Connectivity END
# ----Networking END
# ---Subsystems END
# ---Libraries START
# ----Button and LED Library for Nordic DKs START
CONFIG_DK_LIBRARY=y
# ----Button and LED Library for Nordic DKs END
# ----Hardware ID START
CONFIG_HW_ID_LIBRARY=y
CONFIG_HW_ID_LIBRARY_SOURCE_NET_MAC=y
# ----Hardware ID END
# ---Libraries END
# --Nordic nRF Connect END
# Modules END
#------------------------------------------------------------------------#

#------------------------------------------------------------------------#
# -C Library START
# -- C Library Implementation START
# CONFIG_PICOLIBC=y
# CONFIG_NEWLIB_LIBC
# -- C Library Implementation END
# -C Library END
#------------------------------------------------------------------------#

#------------------------------------------------------------------------#
# -Additional libraries START
# --OS Support Library START
CONFIG_REBOOT=y # Selected by CONFIG_TASK_WDT
# --OS Support Library END
# -Additional libraries END
#------------------------------------------------------------------------#

#------------------------------------------------------------------------#
# -Subsystems and OS Services START
# --System Monitoring Options START
# CONFIG_THREAD_ANALYZER=y #Enable Segger Ozone Support
# CONFIG_THREAD_ANALYZER_AUTO=y # printk/log periotic thread information
# CONFIG_THREAD_ANALYZER_AUTO_INTERVAL=10
# --System Monitoring Options END
# --Debugging Options START
# CONFIG_STACK_SENTINEL=y
# --Debugging Options END
# --File Systems START
# CONFIG_FILE_SYSTEM=y
# CONFIG_FILE_SYSTEM_LITTLEFS=y
# CONFIG_NVS=y
# ---Zephyr Memory Storag(ZMS) START
CONFIG_ZMS=y
# ---Zephyr Memory Storage(ZMS) END
# --File Systems END
# --Logging START
CONFIG_LOG=y
CONFIG_LOG_MODE_DEFERRED=y
# --Logging END
# --Networking START
CONFIG_NETWORKING=y
# CONFIG_NET_SHELL=y
# ---L2 Link layer START
CONFIG_NET_L2_WIFI_SHELL=y
# ---L2 Link layer END
# ---IP Stack START
CONFIG_NET_IPV4=y
CONFIG_NET_IPV6=n
CONFIG_NET_UDP=y
CONFIG_NET_TCP=n
CONFIG_NET_CONNECTION_MANAGER_MONITOR_STACK_SIZE=4850
# ---Network Libraries START
# ----Set network settings for applications START
CONFIG_NET_CONFIG_SETTINGS=y
CONFIG_NET_CONFIG_INIT_TIMEOUT=0
# ----Set network settings for applications END
# ----BSD Sockets compatible API START
# CONFIG_NET_SOCKETS=y
# ----BSD Sockets compatible API END
# ---Network Libraries END
# ---Network additional services START
# ----Network DHCPv4 START
CONFIG_NET_DHCPV4=y # DHCPv4 client, must be disabled for SoftAP
# ----Network DHCPv4 END
# --Network additional services END
# ---Network connection manager START
CONFIG_NET_CONNECTION_MANAGER=y # conn_mgr_*
# ---Network connection manager END
# --Networking END
# --Settings START
CONFIG_SETTINGS=y
# CONFIG_SETTINGS_ZMS=y #default SETTINGS_ZMS if ZMS
# --Settings END
# --Shell START
CONFIG_SHELL=y
CONFIG_SHELL_STACK_SIZE=8192
# --Shell END
# --Random Number Generators START
CONFIG_ENTROPY_GENERATOR=y
# --Random Number Generators END
# --Task-level software watchdog START
CONFIG_TASK_WDT=n # select CONFIG_REBOOT
# --Task-level software watchdog END
# --Zbus support START
CONFIG_ZBUS=y
CONFIG_ZBUS_LOG_LEVEL_INF=y
CONFIG_ZBUS_CHANNEL_NAME=y
CONFIG_ZBUS_OBSERVER_NAME=y
CONFIG_ZBUS_MSG_SUBSCRIBER=y
CONFIG_ZBUS_MSG_SUBSCRIBER_NET_BUF_POOL_SIZE=32
# --Zbus support START
# -Subsystems and OS Services END
#------------------------------------------------------------------------#

#------------------------------------------------------------------------#
# -Build and Link Features START
# -- Compiler Options START
CONFIG_LTO=y
# Disable double promotion warnings in opus library
CONFIG_COMPILER_OPT="-Wno-double-promotion -Wno-maybe-uninitialized -Wno-unused-variable -Wno-stringop-overflow"
# -- Compiler Options END
# -Build and Link Features END
#------------------------------------------------------------------------#
```

## overlay-audio-gateway.conf
```kconfig
#
# Copyright (c) 2025 Nordic Semiconductor ASA
#
# SPDX-License-Identifier: LicenseRef-Nordic-5-Clause
#

CONFIG_AUDIO_GATEWAY=y
# Run as socket sever waiting for client to connect
CONFIG_SOCKET_ROLE_SERVER=y

# -Device Drivers START
# --Wi-Fi drivers START
# ---nRF70 driver START
# Increased from 15000 to handle more scan results (prevents allocation failures)
CONFIG_NRF_WIFI_CTRL_HEAP_SIZE=30000
CONFIG_NRF_WIFI_DATA_HEAP_SIZE=40000
# Critical for socket packet low latency transmission
CONFIG_NRF_WIFI_LOW_POWER=n
CONFIG_NRF70_RX_NUM_BUFS=10
CONFIG_NRF70_RX_MAX_DATA_SIZE=1600
CONFIG_NRF70_MAX_TX_AGGREGATION=4
CONFIG_NRF70_MAX_TX_TOKENS=8
# Increased to accommodate raw PCM frames (1920 bytes + 5 bytes header/footer = 1925 bytes)
CONFIG_NRF70_TX_MAX_DATA_SIZE=2048
# ----nRF70 driver END
# --Wi-Fi drivers END
# -Device Drivers START

# -Subsystems and OS Services START
# --Networking START

# Network buffer management for high throughput
CONFIG_NET_PKT_RX_COUNT=5
CONFIG_NET_PKT_TX_COUNT=10
CONFIG_NET_BUF_RX_COUNT=5
CONFIG_NET_BUF_TX_COUNT=20
# CONFIG_NET_PKT_RX_COUNT*CONFIG_NET_BUF_DATA_SIZE
CONFIG_NET_PKT_BUF_RX_DATA_POOL_SIZE=7500
# CONFIG_NET_PKT_TX_COUNT*CONFIG_NET_BUF_DATA_SIZE
CONFIG_NET_PKT_BUF_TX_DATA_POOL_SIZE=30000
# Network management event queue sizing
CONFIG_NET_MGMT_EVENT_QUEUE_SIZE=10
# CONFIG_NET_MGMT_EVENT_QUEUE_TIMEOUT=5000 (default)

# MDNS Configs
CONFIG_MDNS_RESPONDER=y
CONFIG_DNS_SD=y
CONFIG_MDNS_RESPONDER_DNS_SD=y
CONFIG_NET_HOSTNAME_ENABLE=y
CONFIG_NET_HOSTNAME="audiogateway"
# --Networking END
# -Subsystems and OS Services END
```

## overlay-audio-headset.conf
```kconfig
#
# Copyright (c) 2025 Nordic Semiconductor ASA
#
# SPDX-License-Identifier: LicenseRef-Nordic-5-Clause
#

CONFIG_AUDIO_HEADSET=y
CONFIG_SOCKET_ROLE_CLIENT=y

# -Device Drivers START
# --Wi-Fi drivers START
# ---nRF70 driver START
# Increased from 20000 to handle more scan results (prevents allocation failures)
CONFIG_NRF_WIFI_CTRL_HEAP_SIZE=30000
CONFIG_NRF_WIFI_DATA_HEAP_SIZE=60000
# Critical for socket packet low latency transmission
CONFIG_NRF_WIFI_LOW_POWER=n
CONFIG_NRF70_RX_NUM_BUFS=20
CONFIG_NRF70_RX_MAX_DATA_SIZE=1600
CONFIG_NRF70_MAX_TX_AGGREGATION=2
CONFIG_NRF70_MAX_TX_TOKENS=5
CONFIG_NRF70_TX_MAX_DATA_SIZE=1600
# ----nRF70 driver END
# --Wi-Fi drivers END
# -Device Drivers START

# -Subsystems and OS Services START
# --Networking START
# Network buffer management for high throughput
CONFIG_NET_PKT_RX_COUNT=20
CONFIG_NET_PKT_TX_COUNT=5
CONFIG_NET_BUF_RX_COUNT=20
CONFIG_NET_BUF_TX_COUNT=10
# CONFIG_NET_PKT_RX_COUNT*CONFIG_NET_BUF_DATA_SIZE
CONFIG_NET_PKT_BUF_RX_DATA_POOL_SIZE=30000
# CONFIG_NET_PKT_TX_COUNT*CONFIG_NET_BUF_DATA_SIZE
CONFIG_NET_PKT_BUF_TX_DATA_POOL_SIZE=15000

# Increase connection handlers for DNS-SD/mDNS + application sockets
# Default is 4, but DNS resolver + mDNS + application sockets may need more
CONFIG_NET_MAX_CONN=4


# Network management event queue sizing
CONFIG_NET_MGMT_EVENT_QUEUE_SIZE=10
# CONFIG_NET_MGMT_EVENT_QUEUE_TIMEOUT=5000 (default)

# MDNS Configs
CONFIG_NET_HOSTNAME_ENABLE=y
CONFIG_NET_HOSTNAME="audioheadset"
# Advertise and discover audio services via DNS-SD/mDNS
CONFIG_DNS_SD=y
# Enable the DNS resolver
CONFIG_DNS_RESOLVER=y
# Enable DNS server IP addresses so mDNS multicast address (224.0.0.251) is auto-configured
CONFIG_DNS_SERVER_IP_ADDRESSES=y
# CONFIG_DNS_RESOLVER_LOG_LEVEL_DBG=y
# Enable additional buffers
CONFIG_DNS_RESOLVER_ADDITIONAL_BUF_CTR=5
# Enable additional queries
CONFIG_DNS_RESOLVER_ADDITIONAL_QUERIES=2
# Enable mDNS support
CONFIG_MDNS_RESOLVER=y
# Enable IGMP for mDNS multicast group membership (224.0.0.251)
CONFIG_NET_IPV4_IGMP=y
CONFIG_DNS_RESOLVER_MAX_SERVERS=1
CONFIG_DNS_NUM_CONCUR_QUERIES=1
# DNS resolver cache does not work with the current implementation
#     current debugging gives that the received ttl is 0
# CONFIG_DNS_RESOLVER_CACHE=y
# Set the DNS timeout to 1 second as this is the minimum time, because the dns request are only mDNS and should be fast
CONFIG_NET_SOCKETS_DNS_TIMEOUT=1000

# --Networking END
# -Subsystems and OS Services END
```

## overlay-debug.conf
```kconfig
#
# Copyright (c) 2025 Nordic Semiconductor ASA
#
# SPDX-License-Identifier: LicenseRef-Nordic-5-Clause
#

# Logging
CONFIG_LOG=y
CONFIG_LOG_BUFFER_SIZE=2400
CONFIG_LOG_DEFAULT_LEVEL=3
CONFIG_STREAMCTRL_LOG_LEVEL_DBG=y
# CONFIG_SW_CODEC_SELECT_LOG_LEVEL_DBG=y
# CONFIG_SOCKET_UTILS_LOG_LEVEL_DBG=y
# CONFIG_WIFI_AUDIO_RX_LOG_LEVEL_DBG=y
CONFIG_AUDIO_SYSTEM_LOG_LEVEL_DBG=y
CONFIG_AUDIO_DATAPATH_LOG_LEVEL_DBG=y
# CONFIG_MODULE_AUDIO_USB_LOG_LEVEL_DBG=y

# Stack Debug
# CONFIG_THREAD_ANALYZER=y
# CONFIG_THREAD_ANALYZER_USE_PRINTK=y
# CONFIG_THREAD_ANALYZER_AUTO=y
# CONFIG_THREAD_ANALYZER_AUTO_INTERVAL=10

# Heap Debug
CONFIG_HEAPS_MONITOR=y
CONFIG_SYS_HEAP_LISTENER=y
CONFIG_SYS_HEAP_RUNTIME_STATS=y
```

## overlay-gateway-softap.conf
```kconfig
#
# Copyright (c) 2025 Nordic Semiconductor ASA
#
# SPDX-License-Identifier: LicenseRef-Nordic-5-Clause
#

CONFIG_L2_WIFI_CONNECTIVITY_AUTO_CONNECT=n
CONFIG_L2_WIFI_CONNECTIVITY_AUTO_DOWN=n

# SoftAP Configuration
CONFIG_SOFTAP_REG_DOMAIN="US"
# CONFIG_SOFTAP_BAND_2_4_GHZ=y
# CONFIG_SOFTAP_CHANNEL=2
CONFIG_SOFTAP_BAND_5_GHZ=y
CONFIG_SOFTAP_CHANNEL=165
CONFIG_WIFI_MGMT_AP_STA_INACTIVITY_TIMEOUT=15
CONFIG_WIFI_MGMT_AP_STA_SKIP_INACTIVITY_POLL=n

#------------------------------------------------------------------------#
# -General Kernel Options START
# WPA Supplicant need more memory for AP mode
CONFIG_HEAP_MEM_POOL_SIZE=100000
# -General Kernel Options END

# -Device Drivers START
# --Wi-Fi drivers START
CONFIG_WIFI_NM_WPA_SUPPLICANT_AP=y
# CONFIG_WIFI_MGMT_AP_STA_INACTIVITY_TIMEOUT=0
# CONFIG_WIFI_MGMT_AP_STA_SKIP_INACTIVITY_POLL=n
# fix stack overflow issue
CONFIG_WIFI_NM_WPA_SUPPLICANT_THREAD_STACK_SIZE=8192
# ---nRF70 driver START
CONFIG_NRF70_AP_MODE=y
# ----nRF70 driver END
# --Wi-Fi drivers END
# -Device Drivers START

# Modules START
# --Nordic nRF Connect START
# ---Libraries START
# ----Hardware ID START
CONFIG_HW_ID_LIBRARY=y
CONFIG_HW_ID_LIBRARY_SOURCE_NET_MAC=y
# ----Hardware ID END
# ---Libraries END
# --Nordic nRF Connect END
# Modules END

# -Subsystems and OS Services START
# --Networking START
# ---Network Libraries START
# ----Set network settings for applications START
CONFIG_NET_CONFIG_MY_IPV4_ADDR="192.168.1.1"
CONFIG_NET_CONFIG_MY_IPV4_NETMASK="255.255.255.0"
CONFIG_NET_CONFIG_MY_IPV4_GW="192.168.1.1"
# ----Set network settings for applications END
# ---Network Libraries END
# ---Network additional services START
# ----Network DHCPv4 START
CONFIG_NET_DHCPV4=n # DHCP client has to be disabled for SoftAP.
CONFIG_NET_DHCPV4_SERVER=y
# ----Network DHCPv4 END
# --Network additional services END
# Enable IGMP for mDNS multicast group membership (224.0.0.251)
CONFIG_NET_IPV4_IGMP=y
# --Networking END
# -Subsystems and OS Services END
```

## overlay-heap-debug.conf
```kconfig
#
# Copyright (c) 2024 Nordic Semiconductor ASA
#
# SPDX-License-Identifier: LicenseRef-Nordic-5-Clause
#


CONFIG_HEAPS_MONITOR=y

# Enable heap listener functionality
CONFIG_SYS_HEAP_LISTENER=y
CONFIG_SYS_HEAP_RUNTIME_STATS=y
```

## overlay-latency-measure.conf
```kconfig
#
# Copyright (c) 2025 Nordic Semiconductor ASA
#
# SPDX-License-Identifier: LicenseRef-Nordic-5-Clause
#

# Enable GPIO-based latency measurement system
CONFIG_LATENCY_MEASUREMENT=y

# Configure latency measurement parameters
CONFIG_LATENCY_MEASUREMENT_FRAME_COUNT=10
CONFIG_LATENCY_MEASUREMENT_FRAME_INTERVAL=1000

# GPIO pulse duration
CONFIG_LATENCY_PULSE_DURATION_MS=200

# Enable debug output for timing events (optional)
# CONFIG_LATENCY_MEASUREMENT_DEBUG=y

# Enable GPIO drivers for timing pins
CONFIG_GPIO=y
```

## src/latency_measure.c
```c
/*
 * Copyright (c) 2025 Nordic Semiconductor ASA
 *
 * SPDX-License-Identifier: LicenseRef-Nordic-5-Clause
 */

#include "latency_measure.h"

#ifdef CONFIG_LATENCY_MEASUREMENT

#include <zephyr/drivers/gpio.h>
#include <zephyr/logging/log.h>

LOG_MODULE_REGISTER(latency_measure, CONFIG_LOG_DEFAULT_LEVEL);

/* GPIO pin definitions using new pin assignments */
#define LATENCY_PIN_T1_T5 26 /* P0.26 */
#define LATENCY_PIN_T2_T6 25 /* P0.25 */
#define LATENCY_PIN_T3_T7 7  /* P0.07 */
#define LATENCY_PIN_T4_T8 28 /* P0.28 */

/* GPIO device references */
static const struct device *gpio0_dev;
static const struct device *gpio1_dev;

/* GPIO pin specifications */
static const struct gpio_dt_spec pin_t1_t5 = {.port = DEVICE_DT_GET(DT_NODELABEL(gpio0)),
					      .pin = 26, /* P0.26 */
					      .dt_flags = GPIO_ACTIVE_HIGH};

static const struct gpio_dt_spec pin_t2_t6 = {.port = DEVICE_DT_GET(DT_NODELABEL(gpio0)),
					      .pin = 25, /* P0.25 */
					      .dt_flags = GPIO_ACTIVE_HIGH};

static const struct gpio_dt_spec pin_t3_t7 = {.port = DEVICE_DT_GET(DT_NODELABEL(gpio0)),
					      .pin = 7, /* P0.07 */
					      .dt_flags = GPIO_ACTIVE_HIGH};

static const struct gpio_dt_spec pin_t4_t8 = {.port = DEVICE_DT_GET(DT_NODELABEL(gpio0)),
					      .pin = 28, /* P0.28 */
					      .dt_flags = GPIO_ACTIVE_HIGH};

/* Pulse duration from configuration */
#define PULSE_DURATION_US CONFIG_LATENCY_PULSE_DURATION_MS

/* Work items for timing pulses */
static struct k_work_delayable pulse_work_t1_t5;
static struct k_work_delayable pulse_work_t2_t6;
static struct k_work_delayable pulse_work_t3_t7;
static struct k_work_delayable pulse_work_t4_t8;

/* Work handlers to turn off pins after pulse */
static void pulse_work_handler_t1_t5(struct k_work *work)
{
	gpio_pin_set_dt(&pin_t1_t5, 0);
}

static void pulse_work_handler_t2_t6(struct k_work *work)
{
	gpio_pin_set_dt(&pin_t2_t6, 0);
}

static void pulse_work_handler_t3_t7(struct k_work *work)
{
	gpio_pin_set_dt(&pin_t3_t7, 0);
}

static void pulse_work_handler_t4_t8(struct k_work *work)
{
	gpio_pin_set_dt(&pin_t4_t8, 0);
}

int latency_measure_init(void)
{
	int ret;

	LOG_INF("Initializing latency measurement GPIO pins");

	/* Check if GPIO devices are ready */
	if (!gpio_is_ready_dt(&pin_t1_t5)) {
		LOG_ERR("GPIO device for pin T1/T5 (D2) not ready");
		return -ENODEV;
	}

	if (!gpio_is_ready_dt(&pin_t2_t6)) {
		LOG_ERR("GPIO device for pin T2/T6 (D3) not ready");
		return -ENODEV;
	}

	if (!gpio_is_ready_dt(&pin_t3_t7)) {
		LOG_ERR("GPIO device for pin T3/T7 (D4) not ready");
		return -ENODEV;
	}

	if (!gpio_is_ready_dt(&pin_t4_t8)) {
		LOG_ERR("GPIO device for pin T4/T8 (D5) not ready");
		return -ENODEV;
	}

	/* Configure GPIO pins as outputs */
	ret = gpio_pin_configure_dt(&pin_t1_t5, GPIO_OUTPUT_INACTIVE);
	if (ret) {
		LOG_ERR("Failed to configure GPIO pin T1/T5 (D2): %d", ret);
		return ret;
	}

	ret = gpio_pin_configure_dt(&pin_t2_t6, GPIO_OUTPUT_INACTIVE);
	if (ret) {
		LOG_ERR("Failed to configure GPIO pin T2/T6 (D3): %d", ret);
		return ret;
	}

	ret = gpio_pin_configure_dt(&pin_t3_t7, GPIO_OUTPUT_INACTIVE);
	if (ret) {
		LOG_ERR("Failed to configure GPIO pin T3/T7 (D4): %d", ret);
		return ret;
	}

	ret = gpio_pin_configure_dt(&pin_t4_t8, GPIO_OUTPUT_INACTIVE);
	if (ret) {
		LOG_ERR("Failed to configure GPIO pin T4/T8 (D5): %d", ret);
		return ret;
	}

	/* Initialize work items */
	k_work_init_delayable(&pulse_work_t1_t5, pulse_work_handler_t1_t5);
	k_work_init_delayable(&pulse_work_t2_t6, pulse_work_handler_t2_t6);
	k_work_init_delayable(&pulse_work_t3_t7, pulse_work_handler_t3_t7);
	k_work_init_delayable(&pulse_work_t4_t8, pulse_work_handler_t4_t8);

	LOG_INF("Latency measurement GPIO pins initialized successfully");
	LOG_INF("Pin mapping:");
	LOG_INF("  T1/T5 (Audio Capture/Network RX): P0.26");
	LOG_INF("  T2/T6 (Encode Start/Decode Start): P0.25");
	LOG_INF("  T3/T7 (Encode Complete/Decode Complete): P0.07");
	LOG_INF("  T4/T8 (Network TX/Audio Output): P0.28");
	return 0;
}

/* Helper function to trigger a pin pulse */
static void trigger_pin_pulse(const struct gpio_dt_spec *pin, struct k_work_delayable *work)
{
	/* Set pin high */
	gpio_pin_set_dt(pin, 1);

	/* Cancel any pending work and schedule new work to turn off the pin */
	k_work_cancel_delayable(work);
	k_work_schedule(work, K_MSEC(PULSE_DURATION_US));
}

/* Gateway device timing functions */
void latency_measure_t1_audio_capture(void)
{
#if IS_ENABLED(CONFIG_AUDIO_GATEWAY)
	trigger_pin_pulse(&pin_t1_t5, &pulse_work_t1_t5);
#ifdef CONFIG_LATENCY_MEASUREMENT_DEBUG
	LOG_DBG("T1: Audio capture timing trigger");
#endif
#endif
}

void latency_measure_t2_encode_start(void)
{
#if IS_ENABLED(CONFIG_AUDIO_GATEWAY)
	trigger_pin_pulse(&pin_t2_t6, &pulse_work_t2_t6);
#endif
}

void latency_measure_t3_encode_complete(void)
{
#if IS_ENABLED(CONFIG_AUDIO_GATEWAY)
	trigger_pin_pulse(&pin_t3_t7, &pulse_work_t3_t7);
#endif
}

void latency_measure_t4_network_tx(void)
{
#if IS_ENABLED(CONFIG_AUDIO_GATEWAY)
	trigger_pin_pulse(&pin_t4_t8, &pulse_work_t4_t8);
#endif
}

/* Headset device timing functions */
void latency_measure_t5_network_rx(void)
{
#if IS_ENABLED(CONFIG_AUDIO_HEADSET)
	trigger_pin_pulse(&pin_t1_t5, &pulse_work_t1_t5);
#endif
}

void latency_measure_t6_decode_start(void)
{
#if IS_ENABLED(CONFIG_AUDIO_HEADSET)
	trigger_pin_pulse(&pin_t2_t6, &pulse_work_t2_t6);
#endif
}

void latency_measure_t7_decode_complete(void)
{
#if IS_ENABLED(CONFIG_AUDIO_HEADSET)
	trigger_pin_pulse(&pin_t3_t7, &pulse_work_t3_t7);
#endif
}

void latency_measure_t8_audio_output(void)
{
#if IS_ENABLED(CONFIG_AUDIO_HEADSET)
	trigger_pin_pulse(&pin_t4_t8, &pulse_work_t4_t8);
#ifdef CONFIG_LATENCY_MEASUREMENT_DEBUG
	LOG_DBG("T8: Audio output timing trigger");
#endif
#endif
}

#endif /* CONFIG_LATENCY_MEASUREMENT */
```

## src/latency_measure.h
```c
/*
 * Copyright (c) 2025 Nordic Semiconductor ASA
 *
 * SPDX-License-Identifier: LicenseRef-Nordic-5-Clause
 */

#ifndef LATENCY_MEASURE_H
#define LATENCY_MEASURE_H

#include <zephyr/kernel.h>

/**
 * @brief Initialize latency measurement GPIO pins
 *
 * @return 0 on success, negative error code on failure
 */
int latency_measure_init(void);

/**
 * @brief Trigger timing point for audio input capture (T1)
 * Gateway device only - Arduino pin D2
 */
void latency_measure_t1_audio_capture(void);

/**
 * @brief Trigger timing point for encoding start (T2)
 * Gateway device only - Arduino pin D3
 */
void latency_measure_t2_encode_start(void);

/**
 * @brief Trigger timing point for encoding complete (T3)
 * Gateway device only - Arduino pin D4
 */
void latency_measure_t3_encode_complete(void);

/**
 * @brief Trigger timing point for network transmission (T4)
 * Gateway device only - Arduino pin D5
 */
void latency_measure_t4_network_tx(void);

/**
 * @brief Trigger timing point for network reception (T5)
 * Headset device only - Arduino pin D2
 */
void latency_measure_t5_network_rx(void);

/**
 * @brief Trigger timing point for decoding start (T6)
 * Headset device only - Arduino pin D3
 */
void latency_measure_t6_decode_start(void);

/**
 * @brief Trigger timing point for decoding complete (T7)
 * Headset device only - Arduino pin D4
 */
void latency_measure_t7_decode_complete(void);

/**
 * @brief Trigger timing point for audio output (T8)
 * Headset device only - Arduino pin D5
 */
void latency_measure_t8_audio_output(void);

#endif /* LATENCY_MEASURE_H */
```

## src/zbus_common.h
```c
/*
 * Copyright (c) 2023 Nordic Semiconductor ASA
 *
 * SPDX-License-Identifier: LicenseRef-Nordic-5-Clause
 */

#ifndef _ZBUS_COMMON_H_
#define _ZBUS_COMMON_H_

#ifdef CONFIG_BT
#include <zephyr/bluetooth/audio/audio.h>
#else
/* WiFi audio definitions - no Bluetooth dependencies */
struct bt_conn;
struct bt_le_per_adv_sync;
struct bt_le_ext_adv;
enum bt_audio_dir {
	BT_AUDIO_DIR_SINK,
	BT_AUDIO_DIR_SOURCE,
};
#endif

#define ZBUS_READ_TIMEOUT_MS    K_MSEC(100)
#define ZBUS_ADD_OBS_TIMEOUT_MS K_MSEC(200)

/***** Messages for zbus ******/

enum button_action {
	BUTTON_PRESS = 1,
};

struct button_msg {
	uint32_t button_pin;
	enum button_action button_action;
};

enum le_audio_evt_type {
	LE_AUDIO_EVT_CONFIG_RECEIVED = 1,
	LE_AUDIO_EVT_PRES_DELAY_SET,
	LE_AUDIO_EVT_STREAMING,
	LE_AUDIO_EVT_NOT_STREAMING,
	LE_AUDIO_EVT_SYNC_LOST,
	LE_AUDIO_EVT_NO_VALID_CFG,
	LE_AUDIO_EVT_COORD_SET_DISCOVERED,
};

struct le_audio_msg {
	enum le_audio_evt_type event;
	struct bt_conn *conn;
	struct bt_le_per_adv_sync *pa_sync;
	enum bt_audio_dir dir;
	uint8_t set_size;
	uint8_t const *sirk;
};

/**
 * tx_sync_ts_us	The timestamp from get_tx_sync.
 * curr_ts_us		The current time. This must be in the controller frame of reference.
 */
struct sdu_ref_msg {
	uint32_t tx_sync_ts_us;
	uint32_t curr_ts_us;
	bool adjust;
};

enum bt_mgmt_evt_type {
	BT_MGMT_EXT_ADV_WITH_PA_READY = 1,
	BT_MGMT_CONNECTED,
	BT_MGMT_SECURITY_CHANGED,
	BT_MGMT_PA_SYNCED,
	BT_MGMT_PA_SYNC_LOST,
	BT_MGMT_DISCONNECTED,
};

struct bt_mgmt_msg {
	enum bt_mgmt_evt_type event;
	struct bt_conn *conn;
	uint8_t index;
	struct bt_le_ext_adv *ext_adv;
	struct bt_le_per_adv_sync *pa_sync;
	uint32_t broadcast_id;
	uint8_t pa_sync_term_reason;
};

enum volume_evt_type {
	VOLUME_UP = 1,
	VOLUME_DOWN,
	VOLUME_SET,
	VOLUME_MUTE,
	VOLUME_UNMUTE,
};

struct volume_msg {
	enum volume_evt_type event;
	uint8_t volume;
};

enum content_control_evt_type {
	MEDIA_START = 1,
	MEDIA_STOP,
};

struct content_control_msg {
	enum content_control_evt_type event;
};

#endif /* _ZBUS_COMMON_H_ */
```
